## components/aht20/Kconfig.projbuild
```kconfig
menu "AHT20 Sensor Configuration"

    config AHT_I2C_PORT_NUM
        int "I2C Port Number"
        default 1
        help
            I2C port number for AHT20 sensor (0 or 1). 
            Since SSD1306 uses Port 0, keep this as 1.

    config AHT_SDA_GPIO
        int "AHT20 SDA GPIO"
        default 10
        help
            GPIO number for AHT20 SDA signal.

    config AHT_SCL_GPIO
        int "AHT20 SCL GPIO"
        default 11
        help
            GPIO number for AHT20 SCL signal.

endmenu
```

## components/mqtt_huawei/Kconfig.projbuild
```kconfig
menu "Huawei Cloud IoT Configuration"

    config HWC_MQTT_BROKER_URL
        string "MQTT Broker URL"
        default "YOUR_PROJECT_ID.YOUR_AREA.com:8883"
        help
            Use mqtt:// for port 1883 (No SSL). Use mqtts:// for 8883 (SSL required).
            For project development, mqtt:// (1883) is recommended.

    config HWC_DEVICE_ID
        string "Device ID"
        default "YOUR_DEVICE_ID"
        help
            This is also the MQTT Username.

    config HWC_CLIENT_ID
        string "MQTT Client ID"
        default "YOUR_CLIENT_ID"
        help
            Generated by Huawei Cloud tool.

    config HWC_MQTT_PASSWORD
        string "MQTT Password"
        default "YOUR_MQTT_PASSWORD"
        help
            HMAC-SHA256 generated password.

endmenu
```

## components/network/Kconfig.projbuild.example
```kconfig
menu "Network Configuration"    
    menu "WiFi Configuration"
        config ESP_WIFI_SSID
            string "WiFi SSID"
            default "YOUR_WIFI_SSID"

        config ESP_WIFI_PASSWORD
            string "WiFi Password"
            default "YOUR_WIFI_PASSWORD"
    endmenu

    menu "Local Network Configuration"
        config UDP_TARGET_IP
            string "UDP Broadcast Target IP"
            default "YOUR_TARGET_IP"
            help
                - "255.255.255.255": Global Broadcast (Blocked by some Mobile Hotspots).
                - "192.168.x.255": Subnet Broadcast (Recommended for Hotspots).
                - "192.168.x.x": Unicast to specific PC (Best stability but static IP needed).
    endmenu

    menu "Huawei Cloud IoT Configuration"

    config HWC_MQTT_BROKER_URL
        string "MQTT Broker URL"
        default "YOUR_PROJECT_ID.YOUR_AREA.com:8883"
        help
            Use mqtt:// for port 1883 (No SSL). Use mqtts:// for 8883 (SSL required).
            For project development, mqtt:// (1883) is recommended.

    config HWC_DEVICE_ID
        string "Device ID"
        default "YOUR_DEVICE_ID"
        help
            This is also the MQTT Username.

    config HWC_CLIENT_ID
        string "MQTT Client ID"
        default "YOUR_CLIENT_ID"
        help
            Generated by Huawei Cloud tool.

    config HWC_MQTT_PASSWORD
        string "MQTT Password"
        default "YOUR_MQTT_PASSWORD"
        help
            HMAC-SHA256 generated password.
    endmenu

endmenu
```

## components/sa_hal/Kconfig.projbuild.example
```kconfig
menu "Hardware Nodes Configuration"

    menu "OLED Display Node"
        config NODE_ENABLE_OLED
            bool "Enable SSD1306 OLED Node (Uses Main I2C)"
            default y
    endmenu

    menu "AHT20 Sensor Node"
        config NODE_ENABLE_AHT20
            bool "Enable AHT20 Temp/Humi Node (Uses Main I2C)"
            default y
    endmenu

    menu "Buzzer (Beep) Node"
        config NODE_ENABLE_BEEP
            bool "Enable Buzzer Node"
            default y

        config NODE_BEEP_GPIO_PIN
            int "Buzzer GPIO Pin"
            depends on NODE_ENABLE_BEEP
            default 12

        choice NODE_BEEP_HARDWARE_TYPE
            prompt "Buzzer Hardware Type"
            depends on NODE_ENABLE_BEEP
            default NODE_BEEP_TYPE_ACTIVE

            config NODE_BEEP_TYPE_ACTIVE
                bool "Active Buzzer"
            config NODE_BEEP_TYPE_PASSIVE
                bool "Passive Buzzer"
        endchoice

        choice NODE_BEEP_ACTIVE_LEVEL
            prompt "Buzzer Active Level"
            depends on NODE_BEEP_TYPE_ACTIVE
            default NODE_BEEP_ACTIVE_HIGH

            config NODE_BEEP_ACTIVE_HIGH
                bool "Active High (1 = ON)"
            config NODE_BEEP_ACTIVE_LOW
                bool "Active Low (0 = ON)"
        endchoice

        config NODE_BEEP_PWM_FREQ_HZ
            int "Passive Buzzer Frequency (Hz)"
            depends on NODE_BEEP_TYPE_PASSIVE
            default 2700
    endmenu

endmenu
```

## components/state_machine/Kconfig.projbuild.example
```kconfig
menu "State Machine & Recovery"

    menu "Hardware Recovery Daemon"
        config HW_RECOVERY_ENABLE
            bool "Enable Hardware Recovery Daemon"
            default y

        config HW_RECOVERY_CHECK_PERIOD_MS
            int "Health Check Period (ms)"
            depends on HW_RECOVERY_ENABLE
            default 5000
    endmenu

endmenu
```

## components/wifi/Kconfig.projbuild
```kconfig
menu "WiFi Configuration"
    config ESP_WIFI_SSID
        string "WiFi SSID"
        default "YOUR_WIFI_SSID"

    config ESP_WIFI_PASSWORD
        string "WiFi Password"
        default "YOUR_WIFI_PASSWORD"
endmenu

menu "Local Network Configuration"
    config UDP_TARGET_IP
        string "UDP Broadcast Target IP"
        default "YOUR_TARGET_IP"
        help
            - "255.255.255.255": Global Broadcast (Blocked by some Mobile Hotspots).
            - "192.168.x.255": Subnet Broadcast (Recommended for Hotspots).
            - "192.168.x.x": Unicast to specific PC (Best stability but static IP needed).
endmenu
```

## main/Kconfig.projbuild.example
```kconfig
menu "Main System Configuration"
    
    menu "Display I2C Bus Configuration (I2C0)"
        config MAIN_I2C_PORT_NUM
            int "Display I2C Port Number"
            default 0

        config MAIN_I2C_SDA_GPIO
            int "Display I2C SDA Pin (OLED)"
            default 2

        config MAIN_I2C_SCL_GPIO
            int "Display I2C SCL Pin (OLED)"
            default 1
    endmenu

    menu "Sensor I2C Bus Configuration (I2C1)"
        config SENSOR_I2C_PORT_NUM
            int "Sensor I2C Port Number"
            default 1

        config SENSOR_I2C_SDA_GPIO
            int "Sensor I2C SDA Pin (AHT20)"
            default 4
            help
                Separate SDA pin for sensors to avoid breadboard wire splicing.

        config SENSOR_I2C_SCL_GPIO
            int "Sensor I2C SCL Pin (AHT20)"
            default 5
            help
                Separate SCL pin for sensors to avoid breadboard wire splicing.
    endmenu

endmenu
```
